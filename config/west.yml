## config/west.yml
```yaml
# manifest:
#   remotes:
#     - name: zmkfirmware
#       url-base: https://github.com/zmkfirmware
#     # Additional modules containing boards/shields/custom code can be listed here as well
#     # See https://docs.zephyrproject.org/3.2.0/develop/west/manifest.html#projects
#     - name: Deemen17
#       url-base: https://github.com/Deemen17
#   projects:
#     # - name: zmk
#     #   remote: zmkfirmware
#     #   revision: main
#     #   import: app/west.yml
#     - name: zmk
#       remote: Deemen17
#       revision: main
#       import: app/west.yml
#   self:
#     path: config

manifest:
  remotes:
    - name: bgl314
      url-base: https://github.com/bgl314
  projects:
    - name: zmk
      remote: bgl314
      revision: main
      import: app/west.yml
  self:
    path: config
```
